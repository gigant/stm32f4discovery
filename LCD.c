// Дисплей от нокии 3310 сделан на чипсете PCD8544
// Работает по SPI
// На дисплей заводятся контакты 
// RES - сброс PE13
// SCE - чип селект PE15
// D/C - режим PB11
// SDin - линия PB15
// SCL -  Тактирование PB13 

#include "stm32f4xx.h"
#include "stm32f4xx_gpio.h"
#include "stm32f4xx_rcc.h"
#include "LCD.h"


const uint8_t lcd_nokia1100_decode[] =
{ '0', '1', '2', '3', '4', '5', '6', '7', '8', '9', 'A', 'B', 'C', 'D', 'E',
		'F' };


static __IO uint32_t TimingDelay;

//Задержка в милисекундах
void Delay(__IO uint32_t nCount);

void TimingDelay_Decrement(void)
{
  if (TimingDelay != 0x00)
  { 
    TimingDelay--;
  }
}


void SysTick_Handler(void)
{
  TimingDelay_Decrement();
}


void Delay(__IO uint32_t nTime)
{ 
  TimingDelay = nTime;

  while(TimingDelay != 0);
}


void lcd3310_init_pins()
{
  
RCC_AHB1PeriphClockCmd(sck_port_clock | sdin_port_clock | dc_port_clock | sce_port_clock | res_port_clock, ENABLE);

sck_port->BSRRH = sck_pin;
sdin_port->BSRRH = sdin_pin;
dc_port->BSRRH = dc_pin;
sce_port->BSRRL = sce_pin;
res_port->BSRRH = res_pin;

GPIO_InitTypeDef gpio;
GPIO_StructInit(&gpio);
gpio.GPIO_Mode = GPIO_Mode_OUT;
gpio.GPIO_OType = GPIO_OType_PP;
gpio.GPIO_Pin = sck_pin;
gpio.GPIO_Speed = GPIO_Speed_2MHz;
GPIO_Init(sck_port, &gpio);

gpio.GPIO_Pin = sdin_pin;
GPIO_Init(sdin_port, &gpio);

gpio.GPIO_Pin = dc_pin;
GPIO_Init(dc_port, &gpio);

gpio.GPIO_Pin = sce_pin;
GPIO_Init(sce_port, &gpio);

gpio.GPIO_Pin = res_pin;
GPIO_Init(res_port, &gpio);
}

void lcd3310_init()
{
sce_down;
Delay(1);
res_down;
Delay(10);
res_up;
Delay(1);
sce_up;

Delay(10);

//Function set 00100PVH управление питанием, способ ввода, выбор расширенных инструкций
lcd3310_send_byte(0x21, DC_CMD); // ; кристалл включен, адресация построчная, набор команд расширенный

//Set Vop 1VVVVVVV включить напряжение питания дисплея
lcd3310_send_byte(0x21, DC_CMD);

// Temperature Control
//	 000001TT установить температурный коэффициент
lcd3310_send_byte(0x6, DC_CMD); //TT = 01

//Bias System 00010BBB выбрать систему питания
lcd3310_send_byte(0x13, DC_CMD); //BBB = 011


lcd3310_send_byte(0x20, DC_CMD); // переводим дисплей на обычный набор команд
lcd3310_send_byte(0xC, DC_CMD); //1D0E нормальный режим отображения

}


void lcd3310_send_byte(uint8_t byte, uint8_t dc)
{
if (dc == DC_DATA)
dc_up;
else
dc_down;

Delay(1);

sce_down; //chip select active low

uint8_t i = 0;
uint8_t mask = 0x80;
for (i = 0; i < 8; i++)
{
Delay(1);
sck_down;
Delay(1);

if ((byte & mask) == 0x80)
sdin_up;
else
sdin_down;

Delay(1);

sck_up;
byte <<= 1;
}

Delay(1);
sce_up; //отключаем chip select
Delay(1);
sck_down; // опускаем тактовую ножку, чтобы зря не болталась;
}

const uint8_t lcd_nokia1100_font_5x8[96][5] =
{
	{ 0x00, 0x00, 0x00, 0x00, 0x00 },// (space)
	{ 0x00, 0x00, 0x5F, 0x00, 0x00 },// !
	{ 0x00, 0x07, 0x00, 0x07, 0x00 },// "
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	{ 0x08, 0x1C, 0x2A, 0x08, 0x08 } // <-
};




void lcd3310_print_char(uint8_t simbol)
{
	uint8_t line_number;

	for (line_number = 0; line_number < 5; line_number++)
	{
		lcd3310_send_byte(
				lcd_nokia1100_font_5x8[simbol - 32][line_number],DC_DATA);
	}
        lcd3310_send_byte(0x00,DC_DATA);
}




void lcd3310_clear(void)
{
	uint8_t i;

	lcd3310_send_byte(LCD_NOKIA1100_SET_START_ROW_ADDRESS_6BITS,DC_CMD);
	lcd3310_send_byte(LCD_NOKIA1100_SET_X_ADDRESS_UPPER_3BITS | 0x0,DC_CMD);
	lcd3310_send_byte(LCD_NOKIA1100_SET_X_ADDRESS_LOWER_4BITS | 0x0,DC_CMD);
	lcd3310_send_byte(LCD_NOKIA1100_SET_Y_ADDRESS | 0x0,DC_CMD);
	lcd3310_send_byte(LCD_NOKIA1100_DIPLAY_OFF,DC_CMD);

	for (i = 0; i < 216; i++)
	{
		lcd3310_send_byte(0x00,DC_DATA);
		lcd3310_send_byte(0x00,DC_DATA);
		lcd3310_send_byte(0x00,DC_DATA);
		lcd3310_send_byte(0x00,DC_DATA);
	}

	lcd3310_send_byte(LCD_NOKIA1100_DIPLAY_ON,DC_CMD);
        lcd3310_send_byte(LCD_NOKIA1100_SET_X_ADDRESS_UPPER_3BITS | 0x0,DC_CMD);
	lcd3310_send_byte(LCD_NOKIA1100_SET_X_ADDRESS_LOWER_4BITS | 0x0,DC_CMD);
	lcd3310_send_byte(LCD_NOKIA1100_SET_Y_ADDRESS | 0x0,DC_CMD);
}



/* Функция рисует точку с координатами x,y
// максимальные значения функции 83х47
// в случае ошибочных координат возвращает 0 */

uint8_t lsd3310_point (uint8_t x,uint8_t y)

{  
  if (x>83 || y>47) return 0;
  uint8_t temp=y/8;
  lcd3310_send_byte(0x40 | (y/8),DC_CMD);
  lcd3310_send_byte(0x80 | x,DC_CMD);
  lcd3310_send_byte(0x01<<(y-temp*8),DC_DATA);
  return 1;
}




void lcd3310_print_hex(uint32_t data)
{ 
        lcd3310_print_char(lcd_nokia1100_decode[(data >> 8) & 0x0F]);  
	lcd3310_print_char(lcd_nokia1100_decode[(data >> 4) & 0x0F]);
	lcd3310_print_char(lcd_nokia1100_decode[data & 0x0F]);
}

/*
//-----------------------------------------------------------------------------
void lcd_nokia1100_print_string(uint8_t * string)
{
	lcd_nokia1100_write_command(LCD_NOKIA1100_DIPLAY_OFF);

	while (*string)
	{
		lcd_nokia1100_print_char(*string++);
	}

	lcd_nokia1100_write_command(LCD_NOKIA1100_DIPLAY_ON);
}

void lcd_nokia1100_print_dec_xxx(uint8_t data)
{
	lcd_nokia1100_print_char(lcd_nokia1100_decode[(data / 100) & 0x0F]);
	lcd_nokia1100_print_char(lcd_nokia1100_decode[((data % 100) / 10) & 0x0F]);
	lcd_nokia1100_print_char(lcd_nokia1100_decode[((data % 100) % 10) & 0x0F]);
}

//-----------------------------------------------------------------------------
void lcd_nokia1100_print_dec_xx(uint8_t data)
{
	lcd_nokia1100_print_char(lcd_nokia1100_decode[((data % 100) / 10) & 0x0F]);
	lcd_nokia1100_print_char(lcd_nokia1100_decode[((data % 100) % 10) & 0x0F]);
}*/